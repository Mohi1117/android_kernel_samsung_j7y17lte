## arch/arm64/configs/exynos7870-eng_defconfig
```kconfig
#
# Kernel Performance Events and Counters
#

# CONFIG_HW_PERF_EVENTS=y
# CONFIG_PERF_EVENTS=y
CONFIG_FTRACE=y
CONFIG_HIGH_RES_TIMERS=y
CONFIG_LOCAL_TIMERS=y
CONFIG_GATOR=m

CONFIG_MALI_T83X=y
CONFIG_SOC_EXYNOS7870=y
#
# SAMSUNG EXYNOS SoCs Support
#
CONFIG_EXYNOS_ASV_MARGIN_TEST=y

#
# Kernel hacking
#
CONFIG_SLUB_DEBUG_ON=y
# CONFIG_DEBUG_KMEMLEAK is not set
CONFIG_DEBUG_PREEMPT=y
CONFIG_DEBUG_RT_MUTEXES=y
CONFIG_DEBUG_PI_LIST=y
CONFIG_DEBUG_SPINLOCK=y
CONFIG_DEBUG_MUTEXES=y
CONFIG_DEBUG_LOCK_ALLOC=y
CONFIG_PROVE_LOCKING=y
CONFIG_DEBUG_ATOMIC_SLEEP=y
CONFIG_DEBUG_STACK_USAGE=y
CONFIG_DEBUG_MEMORY_INIT=y
CONFIG_DEBUG_LIST=y
CONFIG_DEBUG_SG=y
CONFIG_SLUB_DEBUG=y

CONFIG_TIMER_STATS=y
CONFIG_SCHEDSTATS=y
CONFIG_SEC_DEBUG_FILE_LEAK=y

#
# RCU Debugging
#
# CONFIG_DEBUG_PAGEALLOC is not set
CONFIG_ATOMIC64_SELFTEST=y

#
# Character devices
#
CONFIG_DEVMEM=y

#
# Support T32 onchip breakpoint
#
CONFIG_SKIP_HW_BREAKPOINT=y

# BAT Automation Test Feature
CONFIG_SEC_BAT_AUT=y

# GPIO DVS
CONFIG_SEC_GPIO_DVS=y

# PMIC DEBUG
CONFIG_SEC_DEBUG_PMIC=y

# BATTERY TEST MODE IN ENG BUILD
CONFIG_SAMSUNG_BATTERY_ENG_TEST=y

# SENSORHUB Debug
CONFIG_SSP_REGISTER_RW=y

# END LINE - Please set CONFIG above this line

# Rooting prevention
#
# CONFIG_SEC_RESTRICT_ROOTING is not set
# CONFIG_SEC_RESTRICT_SETUID is not set
# CONFIG_SEC_RESTRICT_FORK is not set
# CONFIG_SEC_RESTRICT_ROOTING_LOG is not set
```
