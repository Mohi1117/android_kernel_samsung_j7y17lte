/*
 * SAMSUNG UNIVERSAL5433 board device tree source
 *
 * Copyright (c) 2013 Samsung Electronics Co., Ltd.
 *		http://www.samsung.com
 *
 * This program is free software; you can redistribute it and/or modify
 * it under the terms of the GNU General Public License version 2 as
 * published by the Free Software Foundation.
*/

#include "exynos7870-j5y17lte_common_battery.dtsi"
/ {

	battery_params {
			battery,battery_table1 = <188 11 61 11 191 10 64 10 196 9
					75 9 217 8 110 8 13 8 173 7
					66 7 235 6 177 6 132 6 96 6
					67 6 31 6 242 5 164 5 124 5
					23 5 144 1 216 8 105 8 251 7
					141 7 30 7 176 6 65 6 211 5
					101 5 246 4 136 4 25 4 171 3
					60 3 206 2 95 2 241 1 131 1
					20 1 166 0 55 0 201 15>;

			battery,battery_table2 = <50 50 50 50 50 50 51 51 51 52
					52 53 53 54 54 55 55 56 57 59
					63 154>;

			battery,battery_table3 = <140 11 255 10 113 10 229 9 109 9
					254 8 148 8 36 8 206 7 127 7
					30 7 206 6 153 6 113 6 82 6
					55 6 27 6 243 5 186 5 137 5
					187 4 160 1 217 8 107 8 253 7
					144 7 34 7 180 6 70 6 217 5
					107 5 253 4 144 4 34 4 180 3
					71 3 217 2 107 2 254 1 144 1
					34 1 180 0 71 0 217 15>;

			battery,battery_table4 = <48 48 48 48 48 48 48 49 48 48
					48 48 49 49 50 50 51 54 58 66
					96 165>;

			battery,batcap = <0x2D 0xF0 0x0B 0x7C>; /* [0x0F] [0x0E] [0x11] [0x10] */

			battery,soc_arr_evt1 = <10515 10000 9485 8969 8453 7937 7421 6905 6389 5873 5358 4842 4326 3810 3294 2778 2263 1747 1231 716 200 (-269)>;
			battery,ocv_arr_evt1 = <44051 43459 42867 42288 41716 41175 40664 40199 39779 39268 38784 38482 38250 38059 37906 37778 37594 37368 36957 36835 36289 31955>;

			
			battery,soc_arr_evt2 = <11058 10522 9986 9451 8915 8380 7844 7308 6773 6237 5702 5166 4630 4095 3559 3024 2488 1952 1417 881 346 (-190)>;
			battery,ocv_arr_evt2 = <44433 43743 43053 42369 41784 41238 40723 40177 39758 39372 38896 38504 38248 38054 37901 37771 37631 37435 37156 36918 35912 32033>;
			
			battery,FG_Accumulative_rate_evt2 = <0xC2 0x07>;
	};
};
